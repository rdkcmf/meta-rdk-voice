## conf/layer.conf
```bitbake
BBPATH .= ":${LAYERDIR}"

BBFILES += "\
            ${LAYERDIR}/recipes-*/*/*.bb \
            ${LAYERDIR}/recipes-*/*/*.bbappend \
           "

BBFILE_COLLECTIONS += "rdk-voice"
BBFILE_PATTERN_rdk-voice := "^${LAYERDIR}/"
BBFILE_PRIORITY_rdk-voice = "7"

# Additional license directories.
#LICENSE_PATH += "${LAYERDIR}/licenses"

ALEXA_FFV_SUPPORT = "${@bb.utils.contains('DISTRO_FEATURES', 'enable-rdkv-bt-voice', 'false', 'true', d)}"

DISTRO_FEATURES_append = "${@ ' alexa_ffv' if (d.getVar('ALEXA_FFV_SUPPORT',   expand=False) == "true") else ''}"

require conf/include/rdk-bbmasks-voice.inc

##
# To build AVS as plugin - Select wpe-alexa-lib as PREFERRED_PROVIDER & enable alexa-plugin DISTRO FEATURES
# To build AVS as systemd service - Select wpe-alexa as PREFERRED_PROVIDER & comment alexa-plugin DISTRO_FEATURES
##
PREFERRED_PROVIDER_virtual/alexa-device-sdk = "wpe-alexa-lib"
#PREFERRED_PROVIDER_virtual/alexa-device-sdk = "wpe-alexa"

PREFERRED_PROVIDER_virtual/alexa-kwd-detector = "pryonlite"

##
# DISTRO Features:
# alexa_ffv          : Adds Port audio support with ADSDK
# alexa-plugin       : Builds the WPEPluginAVS component
# alexa_smart_screen : Enables Smart screen SDK and related recipes
# voice-chrome       : Adds Voice chrome support (User should get the necessary artifact)
# alexa-sdk-3.0      : Builds AVS SDK 3.0 and related packages
##

DISTRO_FEATURES_append = " alexa-plugin"
#DISTRO_FEATURES_append = " alexa_smart_screen"
DISTRO_FEATURES_append = " voice-chrome"
DISTRO_FEATURES_append = " alexa-sdk-3.0"
```
